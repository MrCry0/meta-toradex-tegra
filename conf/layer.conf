## conf/layer.conf
```bitbake
# We have a conf and classes directory, append to BBPATH
BBPATH .= ":${LAYERDIR}"

# We have recipes-* directories, add to BBFILES
BBFILES += "${LAYERDIR}/recipes-*/*/*.bb ${LAYERDIR}/recipes-*/*/*.bbappend"

BBFILE_COLLECTIONS += "toradex-tegra-layer"
BBFILE_PATTERN_toradex-tegra-layer = "^${LAYERDIR}/"
BBFILE_PRIORITY_toradex-tegra-layer = "22"

# Let us add layer-specific bbappends which are only applied when that
# layer is included in our configuration
BBFILES += "${@' '.join('${LAYERDIR}/%s/recipes*/*/*.bbappend' % layer \
               for layer in BBFILE_COLLECTIONS.split())}"
# Add layer-specific bb files too
BBFILES += "${@' '.join('${LAYERDIR}/%s/recipes*/*/*.bb' % layer \
               for layer in BBFILE_COLLECTIONS.split())}"

LAYERDEPENDS_toradex-tegra-layer = "core"
LAYERSERIES_COMPAT_toradex-tegra-layer = "sumo thud"
```

## conf/machine/apalis-t30.conf
```bitbake
#@TYPE: Machine
#@NAME: apalis_t30
#@DESCRIPTION: Toradex Apalis T30

require conf/machine/include/tegra-base.inc

SOC_FAMILY = "tegra:tegra3"

UBOOT_MACHINE = "apalis_t30_defconfig"
UBOOT_ENTRYPOINT = "0x82008000"
UBOOT_LOADADDRESS = "${UBOOT_ENTRYPOINT}"

# The payload offsets are given in number of 512 byte blocks.
OFFSET_BOOTROM_PAYLOAD = "0"

TEZI_DISTRO_BOOT_SCRIPTS = "boot.scr"
TEZI_ROOT_FSTYPE = "ext3"
TEZI_UBOOT_BINARY_EMMC = "apalis_t30.img"

# require u-boot-dtb-tegra.bin to be used
UBOOT_IMAGE = "u-boot-dtb-tegra-${MACHINE}-${PV}-${PR}.${UBOOT_SUFFIX}"
UBOOT_BINARY = "u-boot-dtb-tegra.${UBOOT_SUFFIX}"
UBOOT_SYMLINK = "u-boot-dtb-tegra-${MACHINE}.${UBOOT_SUFFIX}"

PREFERRED_PROVIDER_lxde-icon-theme_apalis-t30 = "lxde-icon-theme"
PREFERRED_PROVIDER_lxsession-lite_apalis-t30 = "lxsession"
PREFERRED_PROVIDER_virtual/psplash = "psplash-angstrom"
PREFERRED_PROVIDER_psplash-support = "psplash-angstrom"

MACHINE_FEATURES = "screen usbgadget usbhost vfat ext2 alsa touchscreen wifi bluetooth 3g pci "
EXTRA_IMAGEDEPENDS += "u-boot"

# used by sysvinit_2
SERIAL_CONSOLE = "115200 ttyS0"
IMAGE_CLASSES += "image_type_tezi"
IMAGE_FSTYPES = "tar.xz teziimg"

TORADEX_PRODUCT_IDS = "0025 0026 0031"
TORADEX_FLASH_TYPE = "emmc"

DEFAULTTUNE = "armv7athf-neon"
require conf/machine/include/tune-cortexa9.inc
```

## conf/machine/apalis-tk1.conf
```bitbake
#@TYPE: Machine
#@NAME: Toradex Apalis TK1
#@SOC: Tegra K1
#@DESCRIPTION: Machine configuration for Toradex Apalis TK1 SOM
#@MAINTAINER: Marcel Ziswiler <marcel.ziswiler@toradex.com>

MACHINE_NAME = "Apalis-TK1"

require conf/machine/include/soc-family.inc

SOC_FAMILY = "tegra124"

PREFERRED_PROVIDER_virtual/kernel = "linux-toradex"

KERNEL_IMAGETYPE = "zImage"
KERNEL_DEVICETREE += "tegra124-apalis-eval.dtb tegra124-apalis-v1.2-eval.dtb"

MACHINE_BOOT_FILES = "boot.scr"

# wic support
IMAGE_BOOT_FILES ?= " \
    ${KERNEL_IMAGETYPE} \
    ${KERNEL_DEVICETREE} \
    ${MACHINE_BOOT_FILES} \
"
WKS_FILE_DEPENDS ?= " \
    virtual/bootloader \
    u-boot-distro-boot \
    \
    e2fsprogs-native \
    bmap-tools-native \
"

WKS_FILE = "sdimage-bootpart-tegra.wks"
WIC_CREATE_EXTRA_ARGS_append = " --no-fstab-update"

# The kernel lives in a seperate FAT or UBI partition, don't deploy it in /boot
RDEPENDS_${KERNEL_PACKAGE_NAME}-base = ""

PREFERRED_PROVIDER_u-boot = "u-boot-toradex-tk1"
PREFERRED_PROVIDER_virtual/bootloader = "u-boot-toradex-tk1"
PREFERRED_PROVIDER_u-boot-fw-utils ?= "u-boot-toradex-fw-utils-tk1"
UBOOT_MACHINE = "apalis-tk1_defconfig"
UBOOT_ENTRYPOINT = "0x80008000"
UBOOT_LOADADDRESS = "${UBOOT_ENTRYPOINT}"
# The payload offsets are given in number of 512 byte blocks.
OFFSET_BOOTROM_PAYLOAD = "0"

TEZI_DISTRO_BOOT_SCRIPTS = "boot.scr"
TEZI_UBOOT_BINARY_EMMC = "apalis-tk1.img"

# require u-boot-dtb-tegra.bin to be used
UBOOT_IMAGE = "u-boot-dtb-tegra-${MACHINE}-${PV}-${PR}.${UBOOT_SUFFIX}"
UBOOT_BINARY = "u-boot-dtb-tegra.${UBOOT_SUFFIX}"
UBOOT_SYMLINK = "u-boot-dtb-tegra-${MACHINE}.${UBOOT_SUFFIX}"

PREFERRED_PROVIDER_lxde-icon-theme_apalis-tk1 = "lxde-icon-theme"
PREFERRED_PROVIDER_lxsession-lite_apalis-tk1 = "lxsession"

PREFERRED_PROVIDER_virtual/xserver ?= "xserver-xorg"
PREFERRED_PROVIDER_virtual/mesa ?= "mesa"
PREFERRED_PROVIDER_virtual/egl ?= "linux-driver-package"
PREFERRED_PROVIDER_virtual/libgl ?= "linux-driver-package"
PREFERRED_PROVIDER_virtual/libgles1 ?= "linux-driver-package"
PREFERRED_PROVIDER_virtual/libgles2 ?= "linux-driver-package"

#xf86-video-nouveau
#our fs-init may conflict with linux-driver-package-firstboot
XSERVER ?= " \
    xserver-xorg \
    mesa-driver-swrast \
    xf86-input-evdev \
    xf86-input-keyboard \
    xf86-input-mouse \
    xf86-video-modesetting \
    linux-driver-package \
"

MACHINE_FEATURES = "screen usbgadget usbhost vfat ext2 alsa touchscreen wifi bluetooth 3g pci "
MACHINE_EXTRA_RDEPENDS = " \
    tdx-k20-fw \
    linux-driver-package-boot \
    linux-driver-package-firmware \
    linux-driver-package-firstboot \
"
EXTRA_IMAGEDEPENDS += "virtual/bootloader"

# used by sysvinit_2
SERIAL_CONSOLES = "115200;ttyS0"
IMAGE_CLASSES += "image_type_tezi"
IMAGE_FSTYPES += "wic.bmap wic.gz teziimg"

TORADEX_PRODUCT_IDS = "0034"
TORADEX_FLASH_TYPE = "emmc"

DEFAULTTUNE = "cortexa15hf-neon"
require conf/machine/include/tune-cortexa15.inc
```

## conf/machine/colibri-t20.conf
```bitbake
#@TYPE: Machine
#@NAME: colibri_t20
#@DESCRIPTION: Toradex Colibri T20

require conf/machine/include/tegra-base.inc

SOC_FAMILY = "tegra:tegra2"

KERNEL_IMAGETYPE = "zImage"

# U-Boot expects the kernel directly in /boot of the rootfs
MACHINE_ESSENTIAL_EXTRA_RDEPENDS += "kernel-image"

UBOOT_MACHINE = "colibri_t20_defconfig"
UBOOT_ENTRYPOINT = "0x00008000"

PREFERRED_PROVIDER_lxde-icon-theme_colibri-t20 = "lxde-icon-theme"
PREFERRED_PROVIDER_lxsession-lite_colibri-t20 = "lxsession"
PREFERRED_PROVIDER_virtual/psplash = "psplash-angstrom"
PREFERRED_PROVIDER_psplash-support = "psplash-angstrom"

MACHINE_FEATURES = "screen usbgadget usbhost vfat ext2 alsa touchscreen wifi bluetooth 3g"
EXTRA_IMAGEDEPENDS += "u-boot"

# used by sysvinit_2
SERIAL_CONSOLE = "115200 ttyS0"

# T20 does not have neon
DEFAULTTUNE = "armv7athf"
#choose a specific vfp, or we end up with the default vfpv2 optimization
TUNE_CCARGS += "-mfpu=vfpv3-d16"
require conf/machine/include/tune-cortexa9.inc
```

## conf/machine/colibri-t30.conf
```bitbake
#@TYPE: Machine
#@NAME: colibri_t30
#@DESCRIPTION: Toradex Colibri T30

require conf/machine/include/tegra-base.inc

SOC_FAMILY = "tegra:tegra3"

UBOOT_MACHINE = "colibri_t30_defconfig"
UBOOT_ENTRYPOINT = "0x82008000"
UBOOT_LOADADDRESS = "${UBOOT_ENTRYPOINT}"

PREFERRED_PROVIDER_lxde-icon-theme_colibri-t30 = "lxde-icon-theme"
PREFERRED_PROVIDER_lxsession-lite_colibri-t30 = "lxsession"
PREFERRED_PROVIDER_virtual/psplash = "psplash-angstrom"
PREFERRED_PROVIDER_psplash-support = "psplash-angstrom"

MACHINE_FEATURES = "screen usbgadget usbhost vfat ext2 alsa touchscreen wifi bluetooth 3g"
EXTRA_IMAGEDEPENDS += "u-boot"

# used by sysvinit_2
SERIAL_CONSOLE = "115200 ttyS0"

# meta-angstrom/conf/distro/include/arm-defaults.inc
DEFAULTTUNE = "armv7athf-neon"
require conf/machine/include/tune-cortexa9.inc
```

## conf/machine/include/tegra-base.inc
```bitbake
# Provides common Tegra SoC settings

require conf/machine/include/soc-family.inc

# Tegra binaries require a specific X-Server binary ABI
PREFERRED_PROVIDER_virtual/xserver_tegra = "xserver-xorg"
PREFERRED_VERSION_xserver-xorg_tegra = "99:1.14%"
XSERVER = "xserver-xorg \
           xf86-input-evdev \
           xf86-input-mouse \
           xf86-video-fbdev \
           xf86-input-keyboard"

PREFERRED_PROVIDER_virtual/kernel = "linux-toradex"
KERNEL_IMAGETYPE = "zImage"

# wic support
SOC_DEFAULT_IMAGE_FSTYPES = "wic.gz tar.xz"
IMAGE_FSTYPES = "${SOC_DEFAULT_IMAGE_FSTYPES}"

IMAGE_BOOT_FILES ?= " \
    ${KERNEL_IMAGETYPE} \
"
WKS_FILE_DEPENDS ?= " \
    virtual/bootloader \
    \
    e2fsprogs-native \
    bmap-tools-native \
"

SOC_DEFAULT_WKS_FILE ?= "imx-uboot-bootpart.wks"
SOC_DEFAULT_WKS_FILE_mxs ?= "imx-uboot-mxs-bootpart.wks"
WKS_FILE ?= "sdimage-bootpart-tegra.wks"
WIC_CREATE_EXTRA_ARGS_append = " --no-fstab-update"

# The kernel lives in a seperate FAT or UBI partition, don't deploy it in /boot
RDEPENDS_kernel-base = ""

PREFERRED_PROVIDER_u-boot = "u-boot-toradex"
PREFERRED_PROVIDER_virtual/bootloader = "u-boot-toradex"

# require u-boot-dtb-tegra.bin to be used
UBOOT_IMAGE = "u-boot-dtb-tegra-${MACHINE}-${PV}-${PR}.${UBOOT_SUFFIX}"
UBOOT_BINARY = "u-boot-dtb-tegra.${UBOOT_SUFFIX}"
UBOOT_SYMLINK = "u-boot-dtb-tegra-${MACHINE}.${UBOOT_SUFFIX}"

PREFERRED_PROVIDER_virtual/mesa = "mesa"
PREFERRED_PROVIDER_virtual/egl = "tdx-nv-binaries"
PREFERRED_PROVIDER_virtual/libgles1 = "tdx-nv-binaries"
PREFERRED_PROVIDER_virtual/libgles2 = "tdx-nv-binaries"

# Install NV binaries which contains tegra X-Server drivers when X11 is chosen
MACHINE_EXTRA_RRECOMMENDS_append_tegra = " ${@bb.utils.contains('DISTRO_FEATURES', 'x11', 'tdx-nv-binaries', '', d)}"
```
